/**
 * EdgeFlow Framework v1.0
 * models/NaiveBayesRuntime.h
 *
 * Gaussian Naive Bayes inference engine for embedded devices.
 * Reads PROGMEM prior/mean/variance arrays generated by the Python exporter.
 *
 * Array layout (matches exporter.py _header_naive_bayes):
 *   EDGEFLOW_NB_PRIORS[n_classes]                     — class prior probabilities
 *   EDGEFLOW_NB_MEANS[n_classes][n_features]          — per-class feature means
 *   EDGEFLOW_NB_VARS[n_classes][n_features]           — per-class feature variances
 *
 * Inference algorithm:
 *   1. Scale input:   scaled[i] = (input[i] - mean[i]) / scale[i]
 *      (StandardScaler applied before GaussianNB — same as training)
 *   2. For each class c:
 *        log_score[c] = log(prior[c])
 *                     + sum over f of log_gaussian(scaled[f], nb_means[c][f], nb_vars[c][f])
 *      where:
 *        log_gaussian(x, mu, var) = -0.5 * log(2*pi*var) - 0.5*(x-mu)^2/var
 *   3. label = argmax(log_score)
 *   4. Softmax on raw log-scores for confidence percentage
 *
 * Usage:
 *   EdgeFlowResult r = nb_predict(
 *       input, EDGEFLOW_N_FEATURES,
 *       EDGEFLOW_SCALER_MEAN, EDGEFLOW_SCALER_SCALE,
 *       EDGEFLOW_NB_PRIORS,
 *       (const float*)EDGEFLOW_NB_MEANS,
 *       (const float*)EDGEFLOW_NB_VARS,
 *       EDGEFLOW_N_CLASSES, edgeflow_start_timer()
 *   );
 */

#ifndef EDGEFLOW_NB_RUNTIME_H
#define EDGEFLOW_NB_RUNTIME_H

#include <Arduino.h>
#include <math.h>
#include "../EdgeFlowResult.h"
#include "../utils/TimingUtils.h"
#include "../utils/MemoryUtils.h"

// Value of log(2*pi) precomputed to avoid repeated calculation
#define LOG_2PI 1.8378770664093453f

/**
 * Compute log Gaussian likelihood: log P(x | mu, var)
 * Formula: -0.5 * log(2*pi*var) - 0.5 * (x - mu)^2 / var
 *
 * @param x    Observed (scaled) feature value.
 * @param mu   Class-conditional mean for this feature.
 * @param var  Class-conditional variance for this feature.
 * @return     Log probability density.
 */
inline float _nb_log_gaussian(float x, float mu, float var) {
    if (var <= 0.0f) var = 1e-9f;  // guard against zero variance
    float diff = x - mu;
    return -0.5f * (LOG_2PI + logf(var) + (diff * diff) / var);
}

/**
 * Run Gaussian Naive Bayes inference on a raw sensor input array.
 *
 * @param input         Raw (unscaled) sensor feature values.
 * @param n_features    Number of features.
 * @param scaler_mean   PROGMEM float array — StandardScaler means.
 * @param scaler_scale  PROGMEM float array — StandardScaler scales.
 * @param priors        PROGMEM float array — class prior probabilities [n_classes].
 * @param means         PROGMEM float array — class-feature means,
 *                      flattened row-major [n_classes * n_features].
 * @param variances     PROGMEM float array — class-feature variances,
 *                      flattened row-major [n_classes * n_features].
 * @param n_classes     Number of output classes.
 * @param start_time    Timestamp from edgeflow_start_timer().
 *
 * @return EdgeFlowResult with label, confidence, latency_ms, memory_used_kb.
 */
inline EdgeFlowResult nb_predict(
    float*        input,
    int           n_features,
    const float*  scaler_mean,
    const float*  scaler_scale,
    const float*  priors,
    const float*  means,       // flat [n_classes * n_features]
    const float*  variances,   // flat [n_classes * n_features]
    int           n_classes,
    unsigned long start_time
) {
    EdgeFlowResult result;
    result.success        = false;
    result.label          = -1;
    result.confidence     = 0.0f;
    result.latency_ms     = 0.0f;
    result.memory_used_kb = 0.0f;

    // ----------------------------------------------------------------
    // Step 1: Scale input
    // ----------------------------------------------------------------
    float heap_before = edgeflow_free_heap_kb();

    float scaled[16];
    if (n_features > 16) n_features = 16;
    if (n_classes  >  8) n_classes  =  8;

    for (int i = 0; i < n_features; i++) {
        float mean  = pgm_read_float_near(scaler_mean  + i);
        float scale = pgm_read_float_near(scaler_scale + i);
        if (scale == 0.0f) scale = 1.0f;
        scaled[i] = (input[i] - mean) / scale;
    }

    // ----------------------------------------------------------------
    // Step 2: Compute log-posterior for each class
    //   log_score[c] = log(prior[c]) + sum_f log_gaussian(scaled[f], mu_cf, var_cf)
    // ----------------------------------------------------------------
    float log_scores[8];

    for (int c = 0; c < n_classes; c++) {
        float prior = pgm_read_float_near(priors + c);
        float log_score = (prior > 0.0f) ? logf(prior) : -1e9f;

        for (int f = 0; f < n_features; f++) {
            float mu  = pgm_read_float_near(means     + c * n_features + f);
            float var = pgm_read_float_near(variances + c * n_features + f);
            log_score += _nb_log_gaussian(scaled[f], mu, var);
        }

        log_scores[c] = log_score;
    }

    // ----------------------------------------------------------------
    // Step 3: argmax for predicted label
    // ----------------------------------------------------------------
    int   pred_label = 0;
    float max_log    = log_scores[0];

    for (int c = 1; c < n_classes; c++) {
        if (log_scores[c] > max_log) {
            max_log    = log_scores[c];
            pred_label = c;
        }
    }

    // ----------------------------------------------------------------
    // Step 4: Softmax on log-scores for calibrated confidence %
    // Subtract max for numerical stability before exp
    // ----------------------------------------------------------------
    float exp_sum = 0.0f;
    float probs[8];
    for (int c = 0; c < n_classes; c++) {
        probs[c]  = expf(log_scores[c] - max_log);
        exp_sum  += probs[c];
    }

    float pred_conf = 0.0f;
    if (exp_sum > 0.0f) {
        pred_conf = (probs[pred_label] / exp_sum) * 100.0f;
    }

    // ----------------------------------------------------------------
    // Step 5: Fill result
    // ----------------------------------------------------------------
    result.latency_ms     = edgeflow_elapsed_ms(start_time);
    result.memory_used_kb = edgeflow_memory_used_kb(heap_before);
    result.label          = pred_label;
    result.confidence     = pred_conf;
    result.success        = true;

    return result;
}

#endif // EDGEFLOW_NB_RUNTIME_H
