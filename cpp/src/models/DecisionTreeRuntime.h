/**
 * EdgeFlow Framework v1.0
 * models/DecisionTreeRuntime.h
 *
 * Decision Tree inference engine for embedded devices.
 * Reads PROGMEM node arrays generated by the Python exporter.
 *
 * Node format (matches exporter.py _header_decision_tree):
 *   tree_nodes[i] = {feature_index, threshold, left_child, right_child, leaf_label}
 *   - feature_index == -1  => leaf node; leaf_label holds the class index
 *   - feature_index >= 0   => internal node; leaf_label == -1
 *
 * Inference algorithm:
 *   1. Scale input:  scaled[i] = (input[i] - mean[i]) / scale[i]
 *   2. Start at node 0
 *   3. At each node:
 *      - If feature_index == -1: return leaf_label as prediction
 *      - If scaled[feature_index] <= threshold: move to left_child
 *      - Else: move to right_child
 *   4. Confidence = 100.0 / n_classes (uniform, DT has no probability output)
 *
 * Usage (inside your .ino after #include "safenest_model.h"):
 *   EdgeFlowResult r = dt_predict(
 *       input, EDGEFLOW_N_FEATURES,
 *       EDGEFLOW_SCALER_MEAN, EDGEFLOW_SCALER_SCALE,
 *       EDGEFLOW_TREE, EDGEFLOW_TREE_NODES,
 *       EDGEFLOW_N_CLASSES, edgeflow_start_timer()
 *   );
 */

#ifndef EDGEFLOW_DT_RUNTIME_H
#define EDGEFLOW_DT_RUNTIME_H

#include <Arduino.h>
#include "../EdgeFlowResult.h"
#include "../utils/TimingUtils.h"
#include "../utils/MemoryUtils.h"

// Column indices in the flat node array
#define DT_COL_FEATURE   0
#define DT_COL_THRESHOLD 1
#define DT_COL_LEFT      2
#define DT_COL_RIGHT     3
#define DT_COL_LEAF      4

/**
 * Run Decision Tree inference on a raw sensor input array.
 *
 * @param input         Raw (unscaled) feature values from sensors.
 * @param n_features    Number of features (must match EDGEFLOW_N_FEATURES).
 * @param scaler_mean   PROGMEM float array — one mean per feature.
 * @param scaler_scale  PROGMEM float array — one scale per feature.
 * @param tree_nodes    PROGMEM 2D float array — [n_nodes][5] node table.
 * @param n_nodes       Total number of nodes in the tree.
 * @param n_classes     Number of output classes.
 * @param start_time    Timestamp from edgeflow_start_timer() (before call).
 *
 * @return EdgeFlowResult with label, confidence, latency_ms, memory_used_kb.
 */
inline EdgeFlowResult dt_predict(
    float*        input,
    int           n_features,
    const float*  scaler_mean,
    const float*  scaler_scale,
    const float   tree_nodes[][5],
    int           n_nodes,
    int           n_classes,
    unsigned long start_time
) {
    EdgeFlowResult result;
    result.success        = false;
    result.label          = -1;
    result.confidence     = 0.0f;
    result.latency_ms     = 0.0f;
    result.memory_used_kb = 0.0f;

    // ----------------------------------------------------------------
    // Step 1: Scale input features
    // scaled[i] = (input[i] - mean[i]) / scale[i]
    // Use stack allocation — n_features is small (typically 2-10)
    // ----------------------------------------------------------------
    float heap_before = edgeflow_free_heap_kb();

    float scaled[16];  // max 16 features supported
    if (n_features > 16) n_features = 16;

    for (int i = 0; i < n_features; i++) {
        float mean  = pgm_read_float_near(scaler_mean  + i);
        float scale = pgm_read_float_near(scaler_scale + i);
        if (scale == 0.0f) scale = 1.0f;  // guard against division by zero
        scaled[i] = (input[i] - mean) / scale;
    }

    // ----------------------------------------------------------------
    // Step 2: Traverse tree from node 0
    // ----------------------------------------------------------------
    int current_node = 0;
    int max_depth    = n_nodes + 1;  // safety cap to prevent infinite loops
    int prediction   = -1;

    for (int depth = 0; depth < max_depth; depth++) {
        if (current_node < 0 || current_node >= n_nodes) break;

        float feature_idx = pgm_read_float_near(&tree_nodes[current_node][DT_COL_FEATURE]);
        float leaf_label  = pgm_read_float_near(&tree_nodes[current_node][DT_COL_LEAF]);

        if ((int)feature_idx == -1) {
            // Leaf node — return this class
            prediction = (int)leaf_label;
            break;
        }

        // Internal node — compare scaled feature to threshold
        float threshold = pgm_read_float_near(&tree_nodes[current_node][DT_COL_THRESHOLD]);
        float left_idx  = pgm_read_float_near(&tree_nodes[current_node][DT_COL_LEFT]);
        float right_idx = pgm_read_float_near(&tree_nodes[current_node][DT_COL_RIGHT]);

        int feat = (int)feature_idx;
        if (feat >= 0 && feat < n_features && scaled[feat] <= threshold) {
            current_node = (int)left_idx;
        } else {
            current_node = (int)right_idx;
        }
    }

    // ----------------------------------------------------------------
    // Step 3: Fill result
    // ----------------------------------------------------------------
    result.latency_ms     = edgeflow_elapsed_ms(start_time);
    result.memory_used_kb = edgeflow_memory_used_kb(heap_before);

    if (prediction >= 0) {
        result.label      = prediction;
        result.confidence = 100.0f / (float)n_classes;  // uniform: DT has no probability
        result.success    = true;
    }

    return result;
}

#endif // EDGEFLOW_DT_RUNTIME_H
