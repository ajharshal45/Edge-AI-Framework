/**
 * EdgeFlow Framework v1.0
 * models/LogisticRuntime.h
 *
 * Logistic Regression inference engine for embedded devices.
 * Reads PROGMEM weight and bias arrays generated by the Python exporter.
 *
 * Weight layout (matches exporter.py _header_logistic):
 *   EDGEFLOW_LR_WEIGHTS[n_coef_rows][n_features]  — one row per class
 *   EDGEFLOW_LR_BIAS[n_coef_rows]                 — one bias per class
 *
 * Inference algorithm:
 *   1. Scale input:   scaled[i] = (input[i] - mean[i]) / scale[i]
 *   2. For each class c:
 *        score[c] = dot(weights[c], scaled) + bias[c]
 *   3. Binary (n_coef_rows == 1):
 *        p = sigmoid(score[0])
 *        label = (p >= 0.5) ? 1 : 0
 *        confidence = (label == 1) ? p*100 : (1-p)*100
 *   4. Multiclass (n_coef_rows > 1):
 *        softmax(scores) -> probabilities
 *        label = argmax(probabilities)
 *        confidence = max_prob * 100
 *
 * Usage:
 *   EdgeFlowResult r = lr_predict(
 *       input, EDGEFLOW_N_FEATURES,
 *       EDGEFLOW_SCALER_MEAN, EDGEFLOW_SCALER_SCALE,
 *       (const float*)EDGEFLOW_LR_WEIGHTS, EDGEFLOW_LR_BIAS,
 *       EDGEFLOW_N_CLASSES, edgeflow_start_timer()
 *   );
 */

#ifndef EDGEFLOW_LR_RUNTIME_H
#define EDGEFLOW_LR_RUNTIME_H

#include <Arduino.h>
#include <math.h>
#include "../EdgeFlowResult.h"
#include "../utils/TimingUtils.h"
#include "../utils/MemoryUtils.h"

/**
 * Sigmoid activation: 1 / (1 + exp(-x))
 */
inline float _lr_sigmoid(float x) {
    return 1.0f / (1.0f + expf(-x));
}

/**
 * Run Logistic Regression inference on a raw sensor input array.
 *
 * @param input         Raw (unscaled) sensor feature values.
 * @param n_features    Number of features.
 * @param scaler_mean   PROGMEM float array — one mean per feature.
 * @param scaler_scale  PROGMEM float array — one scale per feature.
 * @param weights       PROGMEM float array — weights matrix flattened
 *                      row-major: [row0_f0, row0_f1, ..., row1_f0, ...]
 *                      One row per class (or one row for binary).
 * @param bias          PROGMEM float array — one bias per coef row.
 * @param n_classes     Number of output classes.
 * @param start_time    Timestamp from edgeflow_start_timer().
 *
 * @return EdgeFlowResult with label, confidence, latency_ms, memory_used_kb.
 */
inline EdgeFlowResult lr_predict(
    float*        input,
    int           n_features,
    const float*  scaler_mean,
    const float*  scaler_scale,
    const float*  weights,      // flat row-major [n_coef_rows * n_features]
    const float*  bias,
    int           n_classes,
    unsigned long start_time
) {
    EdgeFlowResult result;
    result.success        = false;
    result.label          = -1;
    result.confidence     = 0.0f;
    result.latency_ms     = 0.0f;
    result.memory_used_kb = 0.0f;

    // ----------------------------------------------------------------
    // Step 1: Scale input features
    // ----------------------------------------------------------------
    float heap_before = edgeflow_free_heap_kb();

    float scaled[16];
    if (n_features > 16) n_features = 16;

    for (int i = 0; i < n_features; i++) {
        float mean  = pgm_read_float_near(scaler_mean  + i);
        float scale = pgm_read_float_near(scaler_scale + i);
        if (scale == 0.0f) scale = 1.0f;
        scaled[i] = (input[i] - mean) / scale;
    }

    // ----------------------------------------------------------------
    // Step 2: Determine coef rows
    // Binary LR: sklearn stores 1 row even for 2 classes.
    // Multiclass: one row per class.
    // ----------------------------------------------------------------
    int n_coef_rows = (n_classes == 2) ? 1 : n_classes;

    // ----------------------------------------------------------------
    // Step 3: Compute raw scores (dot product + bias) per coef row
    // ----------------------------------------------------------------
    float scores[8];  // max 8 classes supported
    if (n_coef_rows > 8) n_coef_rows = 8;

    for (int c = 0; c < n_coef_rows; c++) {
        float dot = 0.0f;
        for (int f = 0; f < n_features; f++) {
            float w = pgm_read_float_near(weights + c * n_features + f);
            dot += w * scaled[f];
        }
        float b = pgm_read_float_near(bias + c);
        scores[c] = dot + b;
    }

    // ----------------------------------------------------------------
    // Step 4: Activation and argmax
    // ----------------------------------------------------------------
    int   pred_label  = 0;
    float pred_conf   = 0.0f;

    if (n_coef_rows == 1) {
        // Binary classification via sigmoid
        float p = _lr_sigmoid(scores[0]);
        if (p >= 0.5f) {
            pred_label = 1;
            pred_conf  = p * 100.0f;
        } else {
            pred_label = 0;
            pred_conf  = (1.0f - p) * 100.0f;
        }
    } else {
        // Multiclass via softmax
        // For numerical stability: subtract max before exp
        float max_score = scores[0];
        for (int c = 1; c < n_coef_rows; c++) {
            if (scores[c] > max_score) max_score = scores[c];
        }

        float exp_sum = 0.0f;
        float probs[8];
        for (int c = 0; c < n_coef_rows; c++) {
            probs[c]  = expf(scores[c] - max_score);
            exp_sum  += probs[c];
        }

        float max_prob = -1.0f;
        for (int c = 0; c < n_coef_rows; c++) {
            probs[c] /= exp_sum;
            if (probs[c] > max_prob) {
                max_prob   = probs[c];
                pred_label = c;
            }
        }
        pred_conf = max_prob * 100.0f;
    }

    // ----------------------------------------------------------------
    // Step 5: Fill result
    // ----------------------------------------------------------------
    result.latency_ms     = edgeflow_elapsed_ms(start_time);
    result.memory_used_kb = edgeflow_memory_used_kb(heap_before);
    result.label          = pred_label;
    result.confidence     = pred_conf;
    result.success        = true;

    return result;
}

#endif // EDGEFLOW_LR_RUNTIME_H
